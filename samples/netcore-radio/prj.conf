## CMakeLists.txt
```
# SPDX-FileCopyrightText: 2026 The MCUHome Contributors
# SPDX-License-Identifier: Apache-2.0
#
# MCUHome network-core image for the nRF5340: the upstream
# zephyr/samples/boards/nordic/ieee802154/802154_rpmsg radio server plus
# the MCUHome entropy service (see README.md for why the two live in one
# image).

cmake_minimum_required(VERSION 3.20.0)

find_package(Zephyr REQUIRED HINTS $ENV{ZEPHYR_BASE})
project(mcuhome-netcore-radio)

target_sources(app PRIVATE
    src/main.c
    src/entropy_service.c)

# The wire protocol header is shared verbatim with the application core.
# Pulled in by path rather than by enabling the MCUHome Zephyr module:
# the module's Kconfig tree assumes an application core (Matter, sensors,
# the channel layer) and none of it belongs in a radio image.
target_include_directories(app PRIVATE ${CMAKE_CURRENT_SOURCE_DIR}/../../include)
```

## sample.yaml
```
# SPDX-FileCopyrightText: 2026 The MCUHome Contributors
# SPDX-License-Identifier: Apache-2.0

sample:
  name: MCUHome network-core radio image
  description: >
    nRF5340 network-core image: the 802.15.4 RPMsg radio server plus the
    MCUHome entropy service, which forwards the network core's RNG
    peripheral to the application core over a second endpoint on the
    existing IPC instance.
common:
  tags:
    - mcuhome
    - ieee802154
    - entropy
tests:
  sample.mcuhome.netcore_radio:
    build_only: true
    platform_allow:
      - nrf7002dk/nrf5340/cpunet
      - nrf5340dk/nrf5340/cpunet
    integration_platforms:
      - nrf7002dk/nrf5340/cpunet
```

## prj.conf
```kconfig
# SPDX-FileCopyrightText: 2026 The MCUHome Contributors
# SPDX-License-Identifier: Apache-2.0
#
# Network-core image configuration. The first block is inherited verbatim
# from the upstream sample this replaces
# (zephyr/samples/boards/nordic/ieee802154/802154_rpmsg/prj.conf) — the
# radio server's behaviour must not change, only gain a second service.

## Disable serial and UART interface.
CONFIG_SERIAL=n
# debug-output: approved upstream-verbatim radio image block, see header
CONFIG_UART_CONSOLE=n

# debug-output: approved upstream-verbatim radio image block, see header
CONFIG_LOG=n

CONFIG_NRF_802154_SER_RADIO=y

# --- MCUHome additions ------------------------------------------------

# Entropy service. Both symbols already default to y on this board — the
# RNG peripheral node is `status = "okay"` and `zephyr,entropy` points at
# it in dts/arm/nordic/nrf5340_cpunet.dtsi, and CONFIG_ENTROPY_NRF5_RNG
# follows from that. They are spelled out anyway: this image exists to
# hand out that peripheral's output, so a board or SoC change that
# silently dropped the driver must break the build here, not produce a
# radio image that answers every entropy request with an error.
CONFIG_ENTROPY_GENERATOR=y
CONFIG_ENTROPY_NRF5_RNG=y

# The entropy endpoint shares the ipc_service instance that already
# carries the 802.15.4 spinel channel (ipc0). CONFIG_IPC_SERVICE and the
# RPMsg backend come from CONFIG_NRF_802154_SER_RADIO; the endpoint
# budget does not need raising, because
# CONFIG_IPC_SERVICE_BACKEND_RPMSG_NUM_ENDPOINTS_PER_INSTANCE defaults to
# 2 and this image uses exactly those two (spinel + entropy). Bluetooth
# is off (ADR 0011), so nothing competes for the second slot.
```

## src/main.c
```c
/*
 * Copyright (c) 2020 Nordic Semiconductor ASA
 *
 * SPDX-FileCopyrightText: 2026 The MCUHome Contributors
 * SPDX-License-Identifier: Apache-2.0
 *
 * Network-core radio image, application entry point.
 *
 * The 802.15.4 serialization server needs no start-up code of its own —
 * it is brought up by a SYS_INIT inside hal_nordic
 * (nrf_802154_init_net.c, POST_KERNEL / CONFIG_NRF_802154_SER_RADIO_INIT_PRIO).
 * All this translation unit contributes are the two fault callouts the
 * serialization layer expects the application to define; they are taken
 * unchanged from the upstream sample this image replaces
 * (zephyr/samples/boards/nordic/ieee802154/802154_rpmsg/src/main.c,
 * Apache-2.0), hence the Nordic copyright line above.
 *
 * The MCUHome entropy service is in src/entropy_service.c and starts
 * itself the same way, one init level later.
 */

#include <zephyr/kernel.h>
#include <zephyr/sys/__assert.h>

#include <nrf_802154_serialization_error.h>

void nrf_802154_serialization_error(const nrf_802154_ser_err_data_t *err)
{
	(void)err;
	__ASSERT(false, "802.15.4 serialization error");
	k_oops();
}

void nrf_802154_sl_fault_handler(uint32_t id, int32_t line, const char *err)
{
	__ASSERT(false, "module_id: %u, line: %d, %s", id, line, err);
	k_oops();
}
```

## src/entropy_service.c
```c
/*
 * SPDX-FileCopyrightText: 2026 The MCUHome Contributors
 * SPDX-License-Identifier: Apache-2.0
 *
 * MCUHome entropy service (network-core side).
 *
 * Serves `struct mcuhome_entropy_ipc_req` on a second endpoint of the
 * IPC instance that already carries the 802.15.4 spinel channel, using
 * this core's RNG peripheral (the application core has none — see
 * include/mcuhome/entropy_ipc.h).
 *
 * Everything here is statically allocated and bounded: one endpoint, one
 * request slot, one response buffer, one thread. No heap.
 */

#include <zephyr/device.h>
#include <zephyr/devicetree.h>
#include <zephyr/drivers/entropy.h>
#include <zephyr/init.h>
#include <zephyr/ipc/ipc_service.h>
#include <zephyr/kernel.h>
#include <zephyr/sys/atomic.h>

#include <mcuhome/entropy_ipc.h>

#include <string.h>

/* Attach to the instance the radio serialization uses, so the entropy
 * endpoint rides on the channel that is guaranteed to exist in this
 * image rather than on an assumed node label.
 */
#if DT_HAS_CHOSEN(nordic_802154_spinel_ipc)
#define ENTROPY_IPC_NODE DT_CHOSEN(nordic_802154_spinel_ipc)
#else
#define ENTROPY_IPC_NODE DT_NODELABEL(ipc0)
#endif

/* Init order: after hal_nordic's serialization_init
 * (POST_KERNEL / CONFIG_NRF_802154_SER_RADIO_INIT_PRIO), which is what
 * actually opens the IPC instance. On this core the backend has the
 * `remote` role, and opening spins until the application core has set up
 * its side (rpmsg_virtio_wait_remote_ready). Running after the radio
 * server means our ipc_service_open_instance() only ever confirms an
 * already-open instance (-EALREADY) instead of adding a second place
 * that can block the single init thread.
 */
#define ENTROPY_SERVICE_INIT_PRIO 60

#if defined(CONFIG_NRF_802154_SER_RADIO_INIT_PRIO)
BUILD_ASSERT(ENTROPY_SERVICE_INIT_PRIO > CONFIG_NRF_802154_SER_RADIO_INIT_PRIO,
	     "entropy service must initialize after the 802.15.4 serialization server");
#endif

/* Serving a request means calling entropy_get_entropy(), which blocks
 * until the RNG peripheral has produced the requested bytes (tens of
 * microseconds each). That must not happen on the IPC mailbox
 * workqueue: the spinel channel's receive path shares that thread, so
 * blocking it stalls the radio. The request is therefore handed to this
 * dedicated thread, which also owns every transmission — the same reason
 * the upstream spinel backend keeps its own send thread.
 *
 * Stack: entropy_get_entropy() and ipc_service_send() are both shallow
 * (a memcpy into a shared-memory buffer at the bottom); 1 KB matches
 * what the spinel send thread needs for a comparable path.
 */
#define ENTROPY_SERVICE_STACK_SIZE 1024

/* Preemptible and low: the radio server must always win. */
#define ENTROPY_SERVICE_PRIO 10

static const struct device *const entropy_dev = DEVICE_DT_GET(DT_CHOSEN(zephyr_entropy));

static struct ipc_ept ept;

/* Handoff from the IPC receive callback to the service thread. One slot,
 * so at most one request is in flight; further requests are dropped
 * while it is occupied and the requester's timeout deals with it.
 * `req_nbytes` is written before the semaphore is given and read after
 * it is taken, which orders the two accesses.
 */
static K_SEM_DEFINE(req_sem, 0, 1);
static atomic_t req_pending;
static uint16_t req_nbytes;

/* Thread-owned response buffer. */
static struct mcuhome_entropy_ipc_rsp rsp;

static void ept_received(const void *data, size_t len, void *priv)
{
	struct mcuhome_entropy_ipc_req req;
	uint16_t nbytes = 0U;

	ARG_UNUSED(priv);

	/* Copy out first: the RPMsg buffer's alignment is the transport's
	 * business, and it is released as soon as this callback returns.
	 */
	if (len == sizeof(req)) {
		memcpy(&req, data, sizeof(req));

		if (req.magic == MCUHOME_ENTROPY_IPC_MAGIC_REQ && req.nbytes > 0U &&
		    req.nbytes <= MCUHOME_ENTROPY_IPC_MAX_BYTES) {
			nbytes = req.nbytes;
		}
	}

	/* A malformed request still gets answered (nbytes == 0), so a
	 * version-skewed peer sees a protocol error instead of a timeout.
	 */
	if (!atomic_cas(&req_pending, 0, 1)) {
		return;
	}

	req_nbytes = nbytes;
	k_sem_give(&req_sem);
}

static struct ipc_ept_cfg ept_cfg = {
	.name = MCUHOME_ENTROPY_IPC_EPT_NAME,
	.cb =
		{
			.received = ept_received,
		},
};

static void entropy_service_thread(void *p1, void *p2, void *p3)
{
	ARG_UNUSED(p1);
	ARG_UNUSED(p2);
	ARG_UNUSED(p3);

	while (true) {
		uint16_t nbytes;

		k_sem_take(&req_sem, K_FOREVER);
		nbytes = req_nbytes;

		rsp.magic = MCUHOME_ENTROPY_IPC_MAGIC_RSP;
		rsp.nbytes = 0U;

		if (nbytes > 0U && entropy_get_entropy(entropy_dev, rsp.bytes, nbytes) == 0) {
			rsp.nbytes = nbytes;
		}

		(void)ipc_service_send(&ept, &rsp, MCUHOME_ENTROPY_IPC_RSP_LEN(rsp.nbytes));

		/* Do not leave seed material lying in this core's RAM. */
		memset(rsp.bytes, 0, sizeof(rsp.bytes));

		atomic_clear(&req_pending);
	}
}

K_THREAD_DEFINE(entropy_service_tid, ENTROPY_SERVICE_STACK_SIZE, entropy_service_thread, NULL, NULL,
		NULL, ENTROPY_SERVICE_PRIO, 0, 0);

static int entropy_service_init(void)
{
	const struct device *const ipc = DEVICE_DT_GET(ENTROPY_IPC_NODE);
	int err;

	if (!device_is_ready(ipc) || !device_is_ready(entropy_dev)) {
		return -ENODEV;
	}

	err = ipc_service_open_instance(ipc);
	if (err < 0 && err != -EALREADY) {
		return err;
	}

	/* Registering announces the endpoint by name; the application core
	 * binds to it whenever it comes up, before or after this point.
	 *
	 * A failure here is reported but not fatal: this image's primary
	 * job is the radio, and killing it would take the whole node down
	 * instead of only its crypto. This core has no log transport
	 * (CONFIG_LOG=n, no console), so the loud failure happens on the
	 * application core, which times out waiting for a seed and refuses
	 * to hand out randomness.
	 */
	return ipc_service_register_endpoint(ipc, &ept, &ept_cfg);
}

SYS_INIT(entropy_service_init, POST_KERNEL, ENTROPY_SERVICE_INIT_PRIO);
```

/*
 * SPDX-FileCopyrightText: 2026 The MCUHome Contributors
 * SPDX-License-Identifier: Apache-2.0
 *
 * Retention area in GPREGRET1, plus the `zephyr,boot-mode` chosen entry
 * that Zephyr's boot-mode API (`bootmode_set()`, `bootmode_check()`) and
 * MCUboot's `CONFIG_BOOT_SERIAL_BOOT_MODE` both resolve. Same shape as
 * the in-tree nRF52840-DK and nRF5340-DK board files, which the
 * nRF7002-DK does not have.
 *
 * GPREGRET1 (not GPREGRET) is the register the in-tree boards use; it
 * survives a soft reset and is cleared by a power-on reset, which is
 * exactly the lifetime a "boot into recovery once" request wants.
 */

/ {
	chosen {
		zephyr,boot-mode = &boot_mode0;
	};
};

&gpregret1 {
	status = "okay";

	boot_mode0: boot_mode@0 {
		compatible = "zephyr,retention";
		status = "okay";
		reg = <0x0 0x1>;
	};
};
